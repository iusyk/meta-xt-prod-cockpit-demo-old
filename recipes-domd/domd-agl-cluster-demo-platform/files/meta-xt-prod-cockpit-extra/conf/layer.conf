## recipes-domd/domd-agl-cluster-demo-platform/files/meta-xt-prod-cockpit-extra/conf/layer.conf
```bitbake
# We have a conf and classes directory, add to BBPATH
BBPATH =. "${LAYERDIR}:"

# We have recipes-* directories, add to BBFILES
BBFILES += "${LAYERDIR}/recipes-*/*/*.bb \
            ${LAYERDIR}/recipes-*/*/*.bbappend"

BBFILE_COLLECTIONS += "meta-xt-prod-cockpit-extra"
BBFILE_PATTERN_meta-xt-prod-cockpit-extra := "^${LAYERDIR}/"
BBFILE_PRIORITY_meta-xt-prod-cockpit-extra = "6"

LAYERSERIES_COMPAT_meta-xt-prod-cockpit-extra = "thud"
```
